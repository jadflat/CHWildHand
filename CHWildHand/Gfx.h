// Gfx.h: all of Wild Hand's drawing, animation and the hidden excitement meter ("heat").
// Included by CHWildHand.ino after the game state; it only reads the game's variables.
// Integer maths only. Art is in Art.h (generated by tools/art.py).
#pragma once
#include "Card.h"
#include "CardIndex.h"
#include "ArtCard.h"     // the pictures are on the SD card (tools/make_card.py)

// ---------------------------------------------------------------- palette
enum : uint8_t { P_BG, P_FELT, P_CARD, P_RED, P_INK, P_GOLD, P_GREY, P_DARK, P_TEXT, P_CHIP, P_SKIN, P_GLOW, P_FELTLT, P_SHADE, P_GOLDDK, P_WINE };
static const uint8_t BASEPAL[16][3] = {
    { 8, 10, 8 }, { 30, 54, 34 }, { 226, 216, 192 }, { 250, 52, 56 }, { 18, 12, 22 }, { 214, 146, 50 }, { 120, 124, 132 }, { 14, 26, 18 },
    { 234, 228, 210 }, { 98, 66, 146 }, { 178, 150, 150 }, { 255, 212, 128 }, { 44, 72, 46 }, { 168, 158, 138 }, { 106, 62, 24 }, { 72, 14, 26 } };
// where the felt colours drift to as the heat rises (the table goes to blood)
#define HOTPAL ((const uint8_t (*)[3])(wh_tabs + T_HOTPAL))   // (in RAM, from the card: tools/tables.py)   // FELT, DARK, FELTLT

// ---------------------------------------------------------------- hooks
// Named events for the sound worker: put a funny sound in gag(). Nothing here changes the game.
enum class Gag : uint8_t { Deal, Pick, Drop, Play, Tally, Pop, BigHand, Clear, Bust, Jackpot, Buy, Broke, Full, Peek, Twitch, Riffle, HeatUp, Blink, Beat };
static void gagHook(Gag g);                      // the sounds (Bonus.h)
static void gag(Gag g) { gagHook(g); }
// The excitement level (0..255) every frame: for the music (tempo, intensity).
static void onHeat(uint8_t level) { synth::heat(level); }
// v0.2+ screens and HUD parts (Bonus.h, included after this file)
static void drawExtra(); static void drawOverlay(); static void drawTimer(); static void playIdle(); static void topBarExtra(int lo, int hi);
static void drawDealerHead(int x, int y, int sc); static void dealerTick();
static void drawPauseMenu(); static void drawTitleMenu(); static void endPrompt(int y);

// ---------------------------------------------------------------- helpers
// The library's RAM-resident routines are 8-byte far calls from flash; one hop each makes every call site 4 bytes.
__attribute__((noinline)) static void hline(int x, int y, int w, uint8_t c) { gfx_hline(x, y, w, c); }
struct GfxClip { int16_t x0, y0, x1, y1; };             // (CHGfx_internal.h: the clip rectangle, half-open)
extern GfxClip gfx__clip;
__attribute__((noinline)) static void pix(int x, int y, uint8_t c) {   // gfx_pixel from flash (the library's is a RAM function)
    const GfxClip k = gfx__clip;
    if ((unsigned)(x - k.x0) >= (unsigned)(k.x1 - k.x0) || (unsigned)(y - k.y0) >= (unsigned)(k.y1 - k.y0)) return;
    uint8_t *p = gfx_fb + y * GFX_FB_STRIDE + (x >> 1);
    *p = (uint8_t)(x & 1 ? (*p & 0x0F) | c << 4 : (*p & 0xF0) | c);
}
// gfx_fillRoundRect / gfx_roundRect for the radii used here (0..5): the library's corner insets r - isqrt(r^2 - (r - i)^2) as a table
static const uint8_t RRIN[15] = { 1, 2, 1, 3, 1, 1, 4, 2, 1, 1, 5, 2, 1, 1, 1 };
__attribute__((noinline)) static void rrect(int x, int y, int w, int h, int r, uint8_t c, bool fill) {
    if (w <= 0 || h <= 0) return;
    int m = (w < h ? w : h) >> 1, cap = (w - 1) / 2, pv = 0;
    if (r > m) r = m;
    if (!fill && !r) { gfx_rect(x, y, w, h, c); return; }
    const uint8_t *in = RRIN + ((r * (r - 1)) >> 1);
    for (int i = 0; i < r; i++) {
        bool full = fill || !i;                                                // (the whole row; else the arc's two short spans)
        int v = in[i] > cap ? cap : in[i], len = full ? w - 2 * v : pv - v > 1 ? pv - v : 1;
        for (int yy = y + i, k = 0; k < 2; k++, yy = y + h - 1 - i) { hline(x + v, yy, len, c); if (!full) hline(x + w - v - len, yy, len, c); }
        pv = v;
    }
    if (fill) gfx_fillRect(x, y + r, w, h - 2 * r, c);
    else { gfx_vline(x, y + r, h - 2 * r, c); gfx_vline(x + w - 1, y + r, h - 2 * r, c); }
}
__attribute__((noinline)) static void whFillRR(int x, int y, int w, int h, int r, uint8_t c) { rrect(x, y, w, h, r, c, true); }
__attribute__((noinline)) static void whRR(int x, int y, int w, int h, int r, uint8_t c) { rrect(x, y, w, h, r, c, false); }
#define gfx_fillRoundRect whFillRR
#define gfx_roundRect whRR
// gfx_line: the same Bresenham steps a pixel at a time (the library's straight-line shortcuts give the same pixels)
__attribute__((noinline)) static void whLine(int x0, int y0, int x1, int y1, uint8_t c) {
    int dx = x1 > x0 ? x1 - x0 : x0 - x1, dy = y1 > y0 ? y1 - y0 : y0 - y1, sx = x0 < x1 ? 1 : -1, sy = y0 < y1 ? 1 : -1, err = dx - dy;
    for (;;) {
        pix(x0, y0, c);
        if (x0 == x1 && y0 == y1) break;
        int e2 = err << 1;
        if (e2 > -dy) { err -= dy; x0 += sx; }
        if (e2 < dx) { err += dx; y0 += sy; }
    }
}
#define gfx_line whLine
#define gfx_clear(c) memset(gfx_fb, (c) * 17, GFX_FB_BYTES)              // (the clip is always the whole screen here)
__attribute__((noinline)) static void remap(int x, int y, int w, int h, const uint8_t *m) { gfx_remapRect(x, y, w, h, m); }   // (the library's, in RAM and word-wide: the pause dim is 5,500 pixels)
// rounded boxes with a radius of 2 or 3 (most of them): one argument less at every call
__attribute__((noinline)) static void rr2(int x, int y, int w, int h, uint8_t c) { gfx_fillRoundRect(x, y, w, h, 2, c); }
__attribute__((noinline)) static void rr3(int x, int y, int w, int h, uint8_t c) { gfx_fillRoundRect(x, y, w, h, 3, c); }
__attribute__((noinline)) static void frame(int x, int y, int w, int h, uint8_t outer, uint8_t fill) { rr2(x, y, w, h, outer); gfx_fillRect(x + 1, y + 1, w - 2, h - 2, fill); }
__attribute__((noinline)) static void rim(int x, int y, int w, int h, uint8_t rimC, uint8_t fillC, int r) { rr3(x, y, w, h, rimC); gfx_fillRoundRect(x + 1, y + 1, w - 2, h - 2, r, fillC); }
// a gold-rimmed dark panel with a stud in each corner (the menus and the bonus stage's rules; the table has none)
static void panel(int x, int y, int w, int h) {
    rim(x, y, w, h, P_GOLDDK, P_BG, 3);
    for (int k = 0; k < 4; k++) pix(x + 2 + (k & 1) * (w - 5), y + 2 + (k >> 1) * (h - 5), P_GOLD);
}
static void textCT(int y, uint8_t g, uint8_t i, uint8_t col);
static uint16_t fc;                              // frame counter (drawing)
#define SIN32 ((const int8_t *)(wh_tabs + T_SIN32))   // (in RAM, from the card: tools/tables.py)
__attribute__((noinline)) static const uint8_t *wildArt(uint8_t id) { const uint8_t *h = wildRec(id); return (const uint8_t *)(uintptr_t)(h[2] | h[3] << 8); }   // (the picture's place, from the card's table)
__attribute__((noinline)) static int isin(int a) { return SIN32[(a >> 3) & 31]; }   // a: 256 = full turn, result -64..64
__attribute__((noinline)) static int isinK(int k) { return isin(fc * k); }                  // isin(fc * k) and isin(fc * k + c): one call each
__attribute__((noinline)) static int isinF(int k, int c) { return isin(fc * k + c); }
static uint32_t frng = 12345;
static uint16_t frand() { frng = frng * 1103515245u + 12345u; return (uint16_t)(frng >> 16); }
__attribute__((noinline)) static int fr(int n) { return frand() % n; }   // frand() % n, as one call

// a picture at s8/8 times its size (8: as drawn, 6: three quarters, 19: the dealer's big head): each source pixel spans the
// floor-spaced screen pixels from (k * s8) >> 3, shifts only, so a fractional size costs what a whole one does
static void drawArtE(const uint8_t *a, int x, int y, int s8, bool black = false) {   // black: the red becomes the black suits' (a court card)
    const uint8_t *p = card::at(CARD_ART + (uint32_t)(uintptr_t)a);    // a picture never crosses a card block
    if (!p) return;
    int h = p[1];
    p += 2;
    for (int r = 0; r < h; r++) {
        int n = *p++, k = 0, x0 = x, y0 = y + (r * s8 >> 3), y1 = y + ((r + 1) * s8 >> 3);
        for (int i = 0; i < n; i++) {
            uint8_t v = *p++;
            k += (v >> 4) + 1;
            int x1 = x + (k * s8 >> 3);
            uint8_t c = v & 15;
            if (c != 15) {
                if (c == 0) c = P_WINE;
                if (black && c == P_RED) c = P_CHIP;
                for (int yy = y0; yy < y1; yy++) hline(x0, yy, x1 - x0, c);   // (fillRect's checks and loop, a run at a time, cost more than the span)
            }
            x0 = x1;
        }
    }
}
static void drawArt(const uint8_t *a, int x, int y, int sc = 1, bool black = false) { drawArtE(a, x, y, sc << 3, black); }
// a bitmap (rows of bits, MSB left, w wide) at rh/4 times its size: each source column/row spans floor-spaced pixels (the INDEX option: 1.5x gives 2-px strokes of 3)
__attribute__((noinline)) static void glyphH(const uint8_t *rows, int n, int w, int x, int y, uint8_t col, int rh) {
    for (int r = 0; r < n; r++) {
        uint8_t b = rows[r];
        int c = 0, y0 = y + (r * rh >> 2), h = y + ((r + 1) * rh >> 2) - y0;
        while (c < w) {
            if (!(b & (0x80 >> c))) { c++; continue; }
            int s0 = c;
            while (c < w && (b & (0x80 >> c))) c++;
            const int xs = x + (s0 * rh >> 2), ww = (c * rh >> 2) - (s0 * rh >> 2);
            if (h == 1) hline(xs, y0, ww, col);   // (a one-pixel row: hline is cheaper than fillRect)
            else gfx_fillRect(xs, y0, ww, h, col);
        }
    }
}
static void glyph(const uint8_t *rows, int n, int w, int x, int y, uint8_t col, int sc = 1) { glyphH(rows, n, w, x, y, col, sc * 4); }
#ifdef PERF_LEAN   // the board's debug build is out of flash: a same-cost stand-in (and the old fixed-size faces below)
static void rank15(int r, int x, int y, uint8_t col) { glyph(RANK8[r], 8, r == 8 ? 8 : 6, x, y, col); }
#else
static void rankS(int r, int x, int y, uint8_t col, int rh) { glyphH(RANK8[r], 8, r == 8 ? 8 : 6, x, y, col, rh); }
#endif
#define SUIT5 ((const uint8_t (*)[5])(wh_tabs + T_SUIT5))   // (in RAM, from the card: tools/tables.py)
// a suit pip, 5x5 or 7x7, at sc times its size
__attribute__((noinline)) static void suit5(int s, int x, int y, uint8_t col, int sc = 1) { glyphH(SUIT5[s], 5, 5, x, y, col, sc * 4); }
__attribute__((noinline)) static void suit7(int s, int x, int y, uint8_t col, int sc = 1) { glyphH(SUIT7[s], 7, 7, x, y, col, sc * 4); }
__attribute__((noinline)) static void suit7sh(int s, int x, int y, uint8_t col, int sc) { suit7(s, x + 1, y + 1, P_SHADE, sc); suit7(s, x, y, col, sc); }
static uint8_t suitCol(uint8_t s) { return s < 2 ? P_RED : P_INK; }
static void textC(int y, const char *s, uint8_t col) { gfx_text((128 - gfx_textWidth(s)) / 2, y, s, col); }
static void textR(int xr, int y, const char *s, uint8_t col) { gfx_text(xr - gfx_textWidth(s) + 1, y, s, col); }
static void textOut(int x, int y, const char *s, uint8_t col, uint8_t sc = 1) { gfx_textFx(x, y, s, sc, col, P_INK); }
__attribute__((noinline)) static void textFxC(int y, const char *s, uint8_t sc, uint8_t col, int shadow, const uint8_t *ramp = nullptr, const int8_t *dy = nullptr) { gfx_textFx((128 - gfx_textWidthScaled(s, sc)) / 2, y, s, sc, col, P_INK, shadow, ramp, dy); }   // centred, outlined
static void textOutC(int y, const char *s, uint8_t col, uint8_t sc = 1) { textFxC(y, s, sc, col, P_INK); }

// ---------------------------------------------------------------- particles
struct Part { int16_t x, y; int8_t vx, vy; uint8_t col, life; };
enum { NPART = 40 };
static Part parts[NPART];
static void spawn(int x, int y, int vx, int vy, uint8_t col, uint8_t life) {
    for (int i = 0; i < NPART; i++) if (!parts[i].life) { parts[i] = { (int16_t)(x << 4), (int16_t)(y << 4), (int8_t)vx, (int8_t)vy, col, life }; return; }
}
// one drifting particle: vx -4..4, vy vy0..vy0 + 15, one of two colours (sparks, confetti, embers, ash, card scraps)
__attribute__((noinline)) static void drift(int x, int y, int vy0, uint8_t c1, uint8_t c2, uint8_t life) { spawn(x, y, fr(9) - 4, vy0 + (int)(frand() & 15), (frand() & 1) ? c1 : c2, life); }
static void confetti() { drift(fr(128), -2, 6, P_GOLD, P_TEXT, 60); }   // a scrap falls from the top
static void burst(int x, int y, int n, uint8_t c1, uint8_t c2, int spd) {
    for (int i = 0; i < n; i++) {
        int a = frand() & 255, s = spd / 2 + fr(spd + 1);
        spawn(x, y, isin(a + 64) * s >> 6, (isin(a) * s >> 6) - 8, (i & 1) ? c1 : c2, 14 + (frand() & 15));
    }
}
static void spark(int x, int y, int w) { drift(x + fr(w), y, -27, P_GLOW, P_GOLD, 12); }
static void bleed(int x, int y);
static void ashAt(int x, int y) { burst(x, y, 12, P_GREY, P_SHADE, 18); spark(x - 8, y, 16); spark(x - 8, y, 16); }   // (a puff of ash, and two embers)
static void partsDraw(uint8_t grav) {
    for (int i = 0; i < NPART; i++) {
        Part &p = parts[i];
        if (!p.life) continue;
        if (!--p.life && p.col == P_RED) bleed(p.x >> 4, p.y >> 4);   // a gib lands and sticks
        p.x += p.vx; p.y += p.vy;
        if (grav && p.vy < 40) p.vy += grav;
        int x = p.x >> 4, y = p.y >> 4;
        if (x < -2 || x > 129 || y > 129) { p.life = 0; continue; }
        if (p.life > 6) gfx_fillRect(x, y, 2, 2, p.col); else pix(x, y, p.col);
    }
}
// ---- blood on the table: splats and smears that dry from red to wine and fade (8 at a time)
static uint8_t stain[8][3], stainK;                  // x, y, life
static void bleed(int x, int y) { uint8_t *s = stain[stainK++ & 7]; s[0] = (uint8_t)x; s[1] = (uint8_t)y; s[2] = fxLow ? 70 : 240; }
static void stainsDraw() {
    for (auto &s : stain) if (s[2]) { uint8_t c = --s[2] > 90 ? P_RED : P_WINE; gfx_fillCircle(s[0], s[1], 4, c); gfx_fillRect(s[0] - 16, s[1], 16, 3, c); }
}

// ---------------------------------------------------------------- heat (hidden excitement meter)
static uint8_t heat, heatFloor, heatForce, streak, flashT, shakeT, shakeAmp;
static int ox, oy;                                     // shake offset for the table layer
#include "Scene.h"   // a backdrop and colours per area
__attribute__((noinline)) static void heatKick(int n) { int h = heat + n; heat = h > 255 ? 255 : h; }
static void heatTick() {
    int prog = 0;
    int32_t g = goal();
    if (state == PLAY || state == RESULT || state == PAUSED) prog = score >= g ? 50 : (int)(score / (g / 50 + 1));
    int base = round_ * 18 + prog + nJok * 5 + (money > 30 ? 10 : (int)money / 3) + streak * 8;
    if ((state == PLAY || state == RESULT) && !timed) base += (PLAYS - playsLeft) * 5;
    if (timed) base = 120 + (tLeft < 300 ? 90 : 0) + turboStage * 15;
    if (round_ == ROUNDS - 1) base += 20;
    if (base > 230) base = 230;
    // the floor ratchets up through the run and never comes down within it
    int fl = round_ * 14;
    if (fl > heatFloor) heatFloor = fl;
    if (state == TITLE) heatFloor = 0;
    int want = base > heatFloor ? base : heatFloor;
    if (heatForce > want) want = heatForce;
    if (state == BONUS || bonusOn) want = 248;              // the bonus stage runs the meter near the top
    uint8_t before = heat;
    if (heat < want) heat++;
    else if (heat > want && !(fc & 3)) heat--;          // decays slowly
    if ((before >> 5) != (heat >> 5) && heat > before) gag(Gag::HeatUp);
    onHeat(heat);
}
static int lvl(int from, int span, int max) {          // 0..max as heat climbs from `from` over `span`
    int v = (heat >> fxLow * fxLow * fxLow) - from;           // the CALM setting halves every effect
    if (v <= 0) return 0;
    v = v * max / span;
    return v > max ? max : v;
}
// the COLORS options (pause menu; tools/colours.py): read from the card's colour block when one changes, into the palette entries below.
// A face's class: 0 light (no remap: the paper is P_CARD, the black suits P_INK), else dark (THREMAP: the paper P_INK, the black suits P_SHADE).
static uint8_t colDark;
enum { COL_TXG = 9, COL_DATG = 11 };                  // the colours' text block (labels, names) and data block (its C_ offsets: CardIndex.h)
static void applyCol() {
    const uint8_t *d = card::at(CARD_TEXT + 512u * COL_DATG);
    if (!d) return;                                      // (no card, or not this frame: the next one)
    if (colDue > 1) memcpy(cop + 1, d + C_PRE + cop[0] * 5, 5);
    const uint8_t *r = d + C_SRC + (colDark = d[C_FCLS + cop[1]]);     // the face's class (x 32) picks the recipes: eight palette entries
    for (int k = 0; k < 8; k++, r += 4) { const uint8_t *p = d + r[1] * 2 + cop[r[2]] * r[3]; gfx_pal[r[0]] = (uint16_t)(p[0] | p[1] << 8); }   // (palTick's entries below mark the palette changed)
    colDue = 0;
}
static void palTick() {
    // warm the felt as heat rises, pulse it, and fade the hit flash
    curScn = scene();
    int warm = curScn == S_TABLE ? lvl(130, 110, 64) : 0; // 0..64
    int pulse = (lvl(70, 120, 24) * isinK(6)) >> 6;    // +-24
    int red = 0, hb = fc % 48;                           // the boss's table beats like a heart: lub-dub, rest
    if (curScn == S_BOSS) { if (hb < 12) red = (hb & 4 ? 10 : 34) - (hb & 8); if (hb == 0) gag(Gag::Beat); }
    if (curScn == S_TITLE) red = 12 + (isinK(1) * 12 >> 6);   // the title's slow red pulse
    // the light flickers now and then: a few frames at half; the title's candlelight wavers always
    static uint8_t flick;
    if (flick) flick--; else if (!fxLow && fr(300) == 0) flick = 3 + (frand() & 7);
    int dim = (flick & 1) ? 32 : curScn == S_TITLE || curScn == S_SHOP ? 56 + (frand() & 7) : 64;
    const uint8_t (*base)[3] = scenePal(curScn);
    if (colDue) applyCol();
    static const uint8_t idx[4] = { P_FELT, P_DARK, P_FELTLT, P_BG };
    for (int k = 0; k < 4; k++) {
        int rgb[3];
        for (int c = 0; c < 3; c++) {
            int v = base[k][c];
            if (k < 3) v += (HOTPAL[k][c] - v) * warm / 64 + pulse * (k == 1 ? 1 : 2) / 3;
            v = v * dim / 64 + (c ? 0 : red);
            rgb[c] = v < 0 ? 0 : v > 255 ? 255 : v;
        }
        gfx_setPaletteEntry(idx[k], gfx_rgb(rgb[0], rgb[1], rgb[2]));
    }
    static bool green;                                   // MATRX: the code rains bright green (and the options' glow comes back after)
    const bool mx = (bgSel ? bgSel + 5 : BGORD[round_ & 7]) == 7 && !fxLow;
    if (mx) gfx_setPaletteEntry(P_GLOW, gfx_rgb(40, 255, 70)); else if (green) colDue = 1;
    green = mx;
    if (fxLow) flashT = 0;
    if (flashT) { gfx_setFade(flashT * 22, gfx_rgb(255, 250, 220)); flashT--; } else gfx_setFade(0);
}

// ---------------------------------------------------------------- background
static void drawFelt() {
    parX += ((state == SHOP ? shopSel : cur) * 48 - parX) >> 3;
    sceneBg();
    const bool dark = curScn == S_TABLE || curScn == S_BOSS;   // (the blood stains and the eyes in the dark)
    if (dark) stainsDraw();
    sceneFg(dark);
}

// ---------------------------------------------------------------- cards
enum { CW = 24, CH = 34 };
enum Frame : uint8_t { F_NONE, F_HOT, F_PICK, F_SCORE };

static void cardShadow(int x, int y, int w, int h) { rr2(x + 1, y + 2, w, h, P_DARK); }
static void drawBack(int x, int y, int w) {
    if (w < 2) { gfx_vline(x, y, CH, P_INK); return; }
    frame(x, y, w, CH, P_INK, P_WINE);
    if (w < 8) return;
    gfx_rect(x + 2, y + 2, w - 4, CH - 4, P_SHADE);           // a bone frame, a sigil line and an open eye
    int cx = x + (w >> 1), cy = y + CH / 2;
    gfx_vline(cx, y + 4, CH - 8, P_GOLDDK);
    if (w < 12) return;
    gfx_fillRect(cx - 4, cy - 1, 9, 3, P_CARD); gfx_fillRect(cx - 2, cy - 2, 5, 5, P_CARD);
    gfx_fillRect(cx - 1, cy - 1, 3, 3, P_RED); pix(cx, cy, P_INK);
    gfx_fillRect(x + 1, y + 1, w - 6, 2, P_RED); gfx_vline(x + 3, y + 3, 7, P_RED); gfx_vline(x + w - 7, y + 3, 4, P_RED);   // blood run down from the top
}
// a card face, w = CW for the full face, narrower while flipping
__attribute__((section(".rodata.court16"))) static const uint16_t COURT16[3] = { 0, (uint16_t)(ART_QUEEN - ART_JACK), (uint16_t)(ART_KING - ART_JACK) };   // (16 bits: half the flash of three pointers)
static_assert(CARD_SONG - CARD_ART <= 65536, "the art's places fit 16 bits (COURT16, Dealers.h DART16)");
#define COURT(i) (ART_JACK + COURT16[i])
#define CARDDIM ((const uint8_t *)(wh_tabs + T_CARDDIM))   // (in RAM, from the card: tools/tables.py)
static bool fullFace = true;                           // false: an overlapped strip, leave the centre art out
// the finish on a face: a shaded right edge and a second rule under it, gold corner studs, and a glint running round a gold frame
static void cardDeco(int x, int y, int w, bool gold) {
    gfx_vline(x + w - 2, y + 4, CH - 8, P_SHADE);
    hline(x + 3, y + CH - 3, w - 6, P_GOLDDK);
    pix(x + 2, y + CH - 4, P_GOLDDK); pix(x + w - 3, y + CH - 4, P_GOLDDK); pix(x + w - 3, y + 2, P_GOLDDK);
    if (gold && !fxLow) { pix(x + 2 + (fc * 2 + x) % (w - 4), y + 1, P_GLOW); pix(x + w - 3 - (fc * 2 + x) % (w - 4), y + CH - 2, P_GLOW); }
}
#define THREMAP ((const uint8_t *)(wh_tabs + T_THREMAP))
#define THDIM ((const uint8_t *)(wh_tabs + T_THDIM))
__attribute__((noinline)) static void themeFace(int x, int y, int w, bool dim, int h = CH) {   // the CARD COLOR theme (or the dimming) on a drawn face
    if (dim || colDark) remap(x + 1, y + 1, w - 2, h - 2, colDark ? (dim ? THDIM : THREMAP) : CARDDIM);
}
#ifdef PERF_LEAN
static void drawFace(int x, int y, Card c, uint8_t fr, int w = CW, bool dim = false) {
    bool gold = fr == F_PICK || fr == F_SCORE;
    rr2(x, y, w, CH, fr == F_HOT ? P_GLOW : P_INK);
    if (gold) { rr2(x + 1, y + 1, w - 2, CH - 2, P_GOLD); gfx_fillRect(x + 3, y + 3, w - 6, CH - 6, P_CARD); }
    else gfx_fillRoundRect(x + 1, y + 1, w - 2, CH - 2, 1, P_CARD);
    hline(x + 3, y + CH - (gold ? 4 : 2), w - 6, P_SHADE);
    if (w < CW) { if (w >= 9) suit7(c.s, x + (w >> 1) - 3, y + 13, suitCol(c.s)); themeFace(x, y, w, dim); return; }
    uint8_t col = suitCol(c.s);
    rank15(c.r, c.r == 8 ? x + 1 : x + 2, y + 3, col);
    suit5(c.s, x + 3, y + 17, col);
    if (!fullFace) {
    } else if (c.r >= 9 && c.r <= 11) {
        drawArt(COURT(c.r - 9), x + 10, y + 14, 1, c.s >= 2);   // (12x16, in the bottom right corner)
        suit5(c.s, x + 13, y + 5, col);
    } else if (c.r == 12) {
        suit7(c.s, x + 9, y + 16, col, 2);
    } else {
        suit7(c.s, x + 13, y + 14, col);
        suit5(c.s, x + 16, y + 26, col);
    }
    themeFace(x, y, w, dim);
}
#else
static void drawFace(int x, int y, Card c, uint8_t fr, int w = CW, bool dim = false) {
    bool gold = fr == F_PICK || fr == F_SCORE;
    rr2(x, y, w, CH, fr == F_HOT ? P_GLOW : P_INK);
    if (gold) { rr2(x + 1, y + 1, w - 2, CH - 2, P_GOLD); gfx_fillRect(x + 3, y + 3, w - 6, CH - 6, P_CARD); }
    else gfx_fillRoundRect(x + 1, y + 1, w - 2, CH - 2, 1, P_CARD);
    hline(x + 3, y + CH - (gold ? 4 : 2), w - 6, P_SHADE);
    if (w < CW) { if (w >= 9) suit7(c.s, x + (w >> 1) - 3, y + 13, suitCol(c.s)); themeFace(x, y, w, dim); return; }
    uint8_t col = suitCol(c.s);
    int idx = fullFace ? idxSz : idxSz > 2 ? 2 : idxSz;                 // (an overlapped strip: at most the MEDIUM index, so the Ten fits)
    int rh = 4 + idx + (idx == 3), big = idx > 2, ss = 1 + (idx == 4), ry = 3 - big;   // the INDEX option: rank rh/4 x, suit x ss; LARGE and HUGE move the art down to the right
    if (!fullFace) {
    } else if (c.r >= 9 && c.r <= 11) {
        drawArt(COURT(c.r - 9), x + 10, y + 14, 1, c.s >= 2);
        if (!big) suit5(c.s, x + 13, y + 5, col);
    } else if (c.r == 12) {
        suit7sh(c.s, x + (big ? ss * 6 + 2 : 9), y + (big ? 18 + 4 * (ss - 1) : 16), col, 3 - ss);   // (with the pip's shadow)
    } else {
        suit7sh(c.s, x + 13 + big, y + 14 + 6 * big, col, 1);
        suit5(c.s, x + 16 + big, y + 26 + big, col);
    }
    if (fullFace) cardDeco(x, y, w, gold);
    rankS(c.r, c.r == 8 ? x + 1 : x + 2, y + ry, col, rh);          // the index last: nothing covers it
    suit5(c.s, x + 5 - 2 * ss, y + ry + 2 * rh + 2, col, ss);
    themeFace(x, y, w, dim);
}
#endif
// a card with a fake rotation: the upper half leans by `sh` px (two draws, clipped)
static void drawFaceSheared(int x, int y, Card c, uint8_t fr, int sh, bool dim = false) {
    if (!sh) { drawFace(x, y, c, fr, CW, dim); return; }
    gfx_setClip(0, 0, 128, y + CH / 2);      drawFace(x + sh, y, c, fr, CW, dim);
    gfx_setClip(0, y + CH / 2, 128, 128);    drawFace(x, y, c, fr, CW, dim);
    gfx_resetClip();
}

// the card under the cursor, a size up so it can be read; its neighbours spread to make room
// the CARD option (pause menu): 0 NORMAL (no zoom), 1 SMALL 28x39, 2 MEDIUM 34x46, 3 LARGE 38x51, 4 HUGE 42x56
#define BWS ((const uint8_t *)(wh_tabs + T_BWS))
#define BHS ((const uint8_t *)(wh_tabs + T_BHS))
#ifdef PERF_LEAN
static void drawFaceBig(int x, int y, Card c, uint8_t fr) {
    int W = BWS[cardSz], H = BHS[cardSz];
    bool court = c.r >= 9 && c.r <= 11, hg = W >= 42;
    rr3(x + 2, y + 3, W, H, P_DARK);
    rim(x, y, W, H, P_INK, fr == F_PICK ? P_GOLD : P_GLOW, 3);
    rr2(x + 3, y + 3, W - 6, H - 6, P_CARD);
    uint8_t col = suitCol(c.s);
    int rs = (W >= 34) + 1;                              // the rank: x2 from 34 wide, never covered by the court art
    bool rm = W < 34;                                    // SMALL: the rank at 1.5x
    if (rm) rank15(c.r, x + 4, y + 4, col); else glyph(RANK8[c.r], 8, c.r == 8 ? 8 : 6, x + 4, y + 3 + rs, col, rs);
    suit5(c.s, x + 4 + hg, rm ? y + 18 : y + 6 + rs * 8 + hg * 2, col, 1 + hg);
    if (court) {                                         // court art x1 beside the rank; x2 on HUGE, under the rank's row
        const uint8_t *p = card::at(CARD_ART + (uint32_t)(uintptr_t)COURT(c.r - 9));
        int s8 = cardSz >= 4 ? 16 : cardSz >= 3 ? 13 : cardSz >= 2 ? 11 : 8, h = (p ? p[1] : 16) * s8 >> 3;   // the portrait scales with the card, in its bottom right corner
        drawArtE(COURT(c.r - 9), x + W - 3 - (12 * s8 >> 3), y + H - 4 - h, s8, c.s >= 2);
    } else {                                             // the pip: x2, x3 for an ace from 34 wide and on HUGE
        int ps = c.r == 12 ? 2 + (W >= 34) : 2 + hg;
        suit7(c.s, x + W - 4 - 7 * ps, c.r == 12 ? y + H - 7 * ps - 4 : hg ? y + 18 : y + H - 7 * ps - (rm ? 6 : 10), col, ps);
        if (hg && c.r != 12) suit5(c.s, x + 26, y + 41, col, 2);
    }
    themeFace(x, y, W, false, H);
}

#else
static void drawFaceBig(int x, int y, Card c, uint8_t fr) {
    int W = BWS[cardSz], H = BHS[cardSz];
    rr3(x + 2, y + 3, W, H, P_DARK);
    rim(x, y, W, H, P_INK, fr == F_PICK ? P_GOLD : P_GLOW, 3);
    rr2(x + 3, y + 3, W - 6, H - 6, P_CARD);
    uint8_t col = suitCol(c.s);
    bool court = c.r >= 9 && c.r <= 11;
    // the index: rank rh/4 x (as the card's width allows), suit x ss, in the top left corner; the art and the pip then keep clear of both
    int rh = idxSz == 4 ? 12 : 4 + idxSz + (idxSz == 3), ss = 1 + (idxSz == 4 && W >= 34), rw = c.r == 8 ? 8 : 6;
    if (rh > (W - 19) * 2 / 3) rh = (W - 19) * 2 / 3;
    int sy = 6 + 2 * rh;
    rw = rw * rh / 4;                                    // (a rank's width, its height is 4 * rh)
    int ib = sy + 5 * ss;                                // the index's bottom
    #define HITS(ax, ay) ((ax < 4 + rw && ay < 4 + 2 * rh) || (ax < 4 + 5 * ss && ay < ib))   // overlaps the rank or the suit (offsets in the card)
    // the court art (x1, x2 on HUGE) or the pip (x2, x3 for an ace from 34 wide, x3 on HUGE) shrinks until it clears it (the CARD size caps the rank so a x1 court always fits beside)
    int sc = c.r == 12 ? 2 + (W >= 34) : 2 + (W >= 42), ax, ay;
    if (court) {                                         // the portrait scales with the card (10..16 eighths), in the bottom right corner opposite the index
        int s8 = 8 + 2 * cardSz;
        for (;; s8--) {
            ax = W - 3 - (12 * s8 >> 3); ay = H - 4 - (16 * s8 >> 3);
            if (s8 <= 8 || !HITS(ax, ay)) break;
        }
        drawArtE(COURT(c.r - 9), x + ax, y + ay, s8, c.s >= 2);
    } else {
        for (;; sc--) {
            ax = W - 4 - 7 * sc; ay = H - 7 * sc - (c.r == 12 ? 4 : 6);
            if (sc == 1 || !HITS(ax, ay)) break;
        }
        suit7(c.s, x + ax, y + ay, col, sc);
    }
    rankS(c.r, x + 4, y + 4, col, rh);
    suit5(c.s, x + 4, y + sy, col, ss);
    themeFace(x, y, W, false, H);
}
#endif

// ---------------------------------------------------------------- the hand, eased
enum { HAND_Y = 98, PICK_UP = 9 };                    // the hand's resting row (the cards' top, the foot of the cards under the screen's edge); a picked card stands 9 higher
static int16_t hx[HANDN], hy[HANDN], hvy[HANDN];        // x16 positions, y velocity
static Card shownC[HANDN];
static int8_t age[HANDN];                              // deal animation; 127 = settled
static bool shownSel[HANDN];
static uint8_t shownN;

static void handTargets(int *tx, int *ty) {
    int n = nHand, s = 26, bw = BWS[cardSz];
    if (n > 2) { s = (cardSz ? 98 - bw : 75) / (n - 2); if (s > 26) s = 26; }   // the room the zoomed card needs
    int extra = s < bw + 2 ? bw + 2 - s : 0;
    int w = n ? (n - 1) * s + extra + CW : 0;
    int left = (128 - w) / 2;
    for (int i = 0; i < n; i++) {
        tx[i] = left + i * s + (i > cur ? extra : 0);
        ty[i] = HAND_Y - (sel[i] ? PICK_UP : 0) - (i == cur ? 3 : 0);
    }
}
static void handSync(bool riffle) {
    int tx[HANDN], ty[HANDN]; handTargets(tx, ty);
    int k = 0;
    Card oc[HANDN]; int16_t ox_[HANDN]; int8_t oa[HANDN];   // a card still in the hand that now lies in another slot (a toss, the sort) slides there from where it was
    memcpy(oc, shownC, sizeof oc); memcpy(ox_, hx, sizeof ox_); memcpy(oa, age, sizeof oa);
    for (int i = 0; i < nHand; i++) {
        bool changed = i >= shownN || shownC[i].r != hand[i].r || shownC[i].s != hand[i].s;
        if (changed) {
            shownC[i] = hand[i];
            int j = shownN;
            while (--j >= 0 && (oc[j].r != hand[i].r || oc[j].s != hand[i].s)) {}
            if (j >= 0) { hx[i] = ox_[j]; age[i] = oa[j]; }
            else { age[i] = (int8_t)(-3 * k++); hx[i] = 104 << 4; hy[i] = (HAND_Y - 14) << 4; hvy[i] = 0; }
        } else if (riffle) {
            hx[i] = (int16_t)(fr(104) << 4); hvy[i] = -16 - (frand() & 15);
        }
        if (sel[i] != shownSel[i]) { if (sel[i]) { hvy[i] = -50; gag(Gag::Pick); } else gag(Gag::Drop); shownSel[i] = sel[i]; }
    }
    shownN = nHand;
}
static void handDraw() {
    int tx[HANDN], ty[HANDN]; handTargets(tx, ty);
    int breath = isinK(6) / 48, drift = lvl(60, 100, 3), shear = timed ? 0 : lvl(110, 120, 2);   // (no shear in the timed plays: the board's frame budget)
    // a tease: one card twitches now and then, more often as heat rises (every P frames, for 6, the cards in turn)
    int P = 1200 / (heat + 8) + 30, tp = fc % P, twitchI = heat > 15 && tp < 6 && nHand ? fc / P % nHand : -1;
    if (twitchI >= 0 && !tp) gag(Gag::Twitch);
    for (int i = 0; i < nHand; i++) {
        if (age[i] < 127) age[i]++;
        bool hot = i == cur, pk = sel[i];
        int gx = tx[i], gy = ty[i];
        if (!hot && !pk) gx += drift * isinF(3, hand[i].r * 71 + hand[i].s * 29) >> 6;   // (the idle cards sway)
        if (hot) gy += breath;                // the highlighted card breathes
        if (age[i] < 0) continue;                        // still in the deck
        hx[i] += ((gx << 4) - hx[i]) >> 1;
        int dy = (gy << 4) - hy[i];
        hvy[i] += dy / 6; hvy[i] = hvy[i] * 3 / 4; hy[i] += hvy[i];
    }
    int bigI = -1;
    for (int i = 0; i < nHand; i++) {
        if (age[i] < 0) continue;
        bool still = sel[i] || i == cur;               // the picked cards and the cursor never shake
        int x = (hx[i] >> 4) + (still ? 0 : ox), y = (hy[i] >> 4) + (still ? 0 : oy);
        if (i == twitchI) { x += (tp & 1) ? 2 : -2; y -= 1; }
        if (age[i] == 0) gag(Gag::Deal);
        cardShadow(x, y, CW, CH);
        if (age[i] < 6 || hidden[i]) { drawBack(x, y, CW); if (age[i] >= 6 && still) gfx_roundRect(x, y, CW, CH, 2, sel[i] ? P_GOLD : P_GLOW); continue; }   // a boss: face down
        int p = age[i] - 6;
        if (p < 3) { int w = CW * (3 - p) / 3; drawBack(x + ((CW - w) >> 1), y, w); continue; }
        if (p < 5) { int w = CW * (p - 2) / 3; drawFace(x + ((CW - w) >> 1), y, hand[i], F_NONE, w); continue; }
        uint8_t fr = sel[i] ? F_PICK : i == cur ? F_HOT : F_NONE;
        if (i == cur && cardSz) { bigI = i; continue; }  // the cursor card is drawn last, big
        int sh = 0;
        if (shear) { sh = shear * isinF(5, hand[i].r * 97 + hand[i].s * 61) / 64; if ((sel[i] || i == cur) && sh) sh = sh > 0 ? 1 : -1; }
        fullFace = i == cur || i + 1 == nHand || (hx[i + 1] >> 4) - (hx[i] >> 4) >= CW || age[i + 1] < 6;
        drawFaceSheared(x, y, hand[i], fr, sh);
        fullFace = true;
    }
    if (bigI >= 0) {
        int bx = hx[bigI] >> 4;                          // left edge on its own slot: the right neighbour starts after it
        if (bx > 126 - BWS[cardSz]) bx = 126 - BWS[cardSz];
        int by = HAND_Y + 33 - BHS[cardSz] + breath - (sel[bigI] ? 4 : 0);
        drawFaceBig(bx, by, hand[bigI], sel[bigI] ? F_PICK : F_HOT);
    }
}

// ---------------------------------------------------------------- HUD
// The table is laid out like the bonus stages: no felt, no panels, and nothing written over the dealer. Under the top
// line the buttons' legend; then the wild cards as a row of small cards (left) and the score, big (right); then a row
// of its own for the hand's name and chips x mult (or the hint); then the dealer's head in the middle with the hands
// and discards left as pips (left) and the goal and the streak (right) beside it; the hand at the foot.
enum { FACE_X = 44, FACE_Y = 52, FACE_S8 = 13,             // the head: 24 px at 13/8, 39 px, centred, under the plate's row
       LEG_Y = 13, SLOT_Y = 22, SCORE_Y = 23, SCORE_R = 125, HINT_Y = 43, GOAL_Y = 56, PIPS_Y = 56 };
static int32_t dispScore;
static uint8_t popT;
static int slotX(int i) { return 1 + i * 13; }
// a wild card's picture on its slot colour, from its record (s8: eighths of its 16x16)
static void wildPic(const uint8_t *h, int x, int y, int s8) {
    gfx_fillRect(x, y, s8 * 2, s8 * 2, h[1] & 15);
    drawArtE((const uint8_t *)(uintptr_t)(h[2] | h[3] << 8), x, y, s8);
}
static void drawJokerSlots() {                         // small cards: the picture at 3/4 over a dark foot with the meter
    for (int i = 0; i < JMAX; i++) {
        int xx = slotX(i), p = slotPop[i];
        if (i >= nJok) { gfx_roundRect(xx, SLOT_Y, 14, 18, 2, P_INK); continue; }
        const uint8_t *h = wildRec(jokers[i]);
        bool burn = burnMask >> i & 1;
        if (p) { slotPop[i]--; xx += (p & 1) ? (p >> 2) : -(p >> 2); }   // a pop: the slot jumps and shakes, a bright rim round it
        int yy = SLOT_Y - (p > 4 ? 2 : p > 1 ? 1 : 0);
        rr2(xx, yy, 14, 18, p ? P_GLOW : P_GOLDDK);
        wildPic(h, xx + 1, yy + 1, 6);
        gfx_fillRect(xx + 1, yy + 13, 12, 4, P_INK);
        if (p > 3) gfx_rect(xx - 1, yy - 1, 16, 20, P_GLOW);
        int m = h[0] >> 6, c = cnt[i], par = h[1] >> 4;
        if (m == 1) { if (c) gfx_fillRect(xx + 1, yy + 14, (c * 3 + 3) >> 2, 2, p ? P_TEXT : P_GLOW); }              // a growth bar: three quarters of a pixel a point
        else if (m == 2) for (int k = 0; k < par; k++) gfx_fillRect(xx + 1 + k * (12 / par), yy + 14, 12 / par - 1, 2, k < c ? P_GLOW : P_DARK);   // a charge meter: a segment a charge
        else if (m == 3 && !burn) pix(xx + 3 + ((fc + i * 5) & 7), yy + 1, fc & 1 ? P_GOLD : P_GLOW);   // a burner's ember
        if (burn) { remap(xx + 1, yy + 1, 12, 12, CARDDIM); if (!(fc & 1)) drift(xx + 2 + fr(10), yy + 12, 2, P_GREY, P_SHADE, 18); }   // ash falls from a burning card
    }
}
// the numbers that float up from a wild card's slot when it fires (Rules.h fl[]), after the HUD so nothing covers them
static void floatTick() {
    for (Fl &f : fl) {
        if (!f.kind) continue;
        int k = f.kind - 1, x = slotX(f.slot) + 7;
        if (f.t < 0) {
            if (++f.t < 0) continue;
            slotPop[f.slot] = 8;                            // the slot pops, a blip, a puff
            playSfx(k == 2 ? Sfx::Buy : k == 6 ? Sfx::Snap : Sfx::Bleep, (uint8_t)(k * 2));
            if (!fxLow) { if (burnMask >> f.slot & 1) ashAt(x, SLOT_Y + 9); else burst(x, SLOT_Y + 7, 5, k == 1 || k == 6 ? P_RED : P_GOLD, P_GLOW, 16); }
        } else f.t++;
        if (f.t > 22) { f.kind = 0; continue; }
        const uint8_t *COL = wh_tabs + T_FCOL;
        const char *b = strf("%s%d", f.val < 0 ? "-" : k == 2 ? "$" : k == 6 ? "X" : "+", f.val < 0 ? -f.val : f.val);   // +4 chips or mult, $1, X2; a minus for a cost
        int w = gfx_textWidth(b) + 4, yy = SLOT_Y + 1 - (f.t > 12 ? 12 : f.t), xx = x - (w >> 1);
        if (xx < 0) xx = 0;
        if (f.t > 17 && (f.t & 1)) continue;
        rr2(xx, yy, w, 9, COL[k]);
        gfx_text(xx + 2, yy + 1, b, P_TEXT);
    }
}
static void btnGlyph(int x, int y, char ch) {
    gfx_fillCircle(x + 4, y + 4, 4, P_GREY);
    if (ch == 94) for (int i = 0; i < 3; i++) hline(x + 4 - i, y + 2 + i, 2 * i + 1, P_INK);   // an up arrow
    else { char s[2] = { ch, 0 }; gfx_text(x + 2, y + 1, s, P_INK); }
}
__attribute__((noinline)) static void blinkA() { if ((fc % 30) < 20) btnGlyph(117, 117, 'A'); }   // the A button, blinking in the corner: press on
static void barGlint() { hline((fc * 3) % 200 - 40, 11, 6, P_GLOW); }   // a glint runs along the gold rule
static void drawTopBar() {
    const char *s;
    gfx_fillRect(0, 0, 128, 11, P_BG);
    hline(0, 10, 128, P_WINE);
    hline(0, 11, 128, P_GOLDDK);
    barGlint();
    bool bossOn = boss != 255 && !timed && (state == PLAY || state == RESULT || state == PAUSED || state == DEAL), red = bossOn;
    if (mode == M_TURBO) s = strf(miscText(TX_M_TURBO), (long)turboHi);
    else if (bonusOn || state == BONUS || state == MINI || state == TIMEUP) { s = miscText(TX_M_NM); red = true; }
    else s = strf(miscText(bossOn ? TX_M_HEX : TX_M_NIGHT), round_ + 1);
    gfx_text(3, 2, s, red ? P_RED : P_TEXT);
    int lo = 7 + gfx_textWidth(s), hi = 124;
    if (mode != M_TURBO) { s = strf("$%d", (int)money); textR(124, 2, s, P_GOLD); hi = 121 - gfx_textWidth(s); }
    topBarExtra(lo, hi);
}
static void drawHud() {
    drawTopBar();
    // progress: a two-pixel line under the top bar, the whole width
    int32_t t = goal(), m = dispScore < t ? dispScore : t;
    int w = t < 10000000 ? (int)(128 * m / t) : (int)(m / (t / 128));   // (no overflow in endless play)
    if (dispScore > 0 && w < 2) w = 2;
    if (w > 0) gfx_fillRect(0, 11, w, 2, dispScore >= t ? P_GLOW : P_GOLD);
    barGlint();
    // the dealer, big, keeps an eye on you (behind everything else on the table)
    dealerTick();
    if (state != PAUSED) drawDealerHead(FACE_X, FACE_Y + isinK(4) / 48, FACE_S8);   // (under the pause menu it would not show)
    drawJokerSlots();
    // the score rolls up, then pops
    int32_t want = score + (state == RESULT && timer >= resEnd() + 8 ? lastGain : 0);
    if (want < dispScore) dispScore = want;
    else if (want > dispScore) {
        int32_t st = (want - dispScore) / 5, was = dispScore; dispScore += st ? st : 1;
        if (dispScore == want) { popT = 8; gag(Gag::Pop); }
        if (!(fc & 1)) spark(SCORE_R - 50, SCORE_Y + 14, 50);         // the count throws sparks
        if (was < t && dispScore >= t) { flashT = 5; shakeT = 14; shakeAmp = 3; burst(SCORE_R - 24, SCORE_Y + 6, 18, fxLow ? P_GOLD : P_RED, curScn == S_BOSS ? P_CARD : P_GOLD, 44); if (curScn == S_BOSS) { bleed(40, 64); bleed(100, 108); } }   // past the goal: blood (and bone, on a beaten hex)
    }
    if (popT) popT--;
    const char *s = strf("%ld", (long)dispScore);
    int sc = gfx_textWidthScaled(s, 2) > 58 ? 1 : 2, sw = gfx_textWidthScaled(s, sc);   // (right of the wild cards: x1 from seven digits)
    gfx_textFx(SCORE_R - sw, SCORE_Y + (2 - sc) * 4 - (popT > 4 ? 1 : 0), s, sc, popT ? P_GLOW : P_TEXT, P_INK);
    if (popT) gfx_rect(SCORE_R - 3 - sw, SCORE_Y - 3, sw + 6, 20, popT > 4 ? P_GLOW : P_GOLD);       // a rim flashes round the number as it lands
    s = strf("/%d", t);
    textOut(SCORE_R - gfx_textWidth(s), GOAL_Y, s, P_GOLD);
    for (int i = 0; i < streak && i < 5; i++) {                                          // a hot streak: a flame a hand, under the goal
        int fx = SCORE_R - 3 - i * 6, f = ((fc >> 1) + i) & 1, fy = GOAL_Y + 10;
        gfx_fillRect(fx, fy + 1 + f, 3, 6 - f, P_RED); gfx_vline(fx + 1, fy + 2 + f, 3, P_GOLD);
    }
    floatTick();
    // plays and discards as pips, each beside the button that spends it
    if (timed) { drawTimer(); return; }
    int n = discLeft > DISCS ? discLeft : DISCS, np = playsLeft > PLAYS ? playsLeft : PLAYS;   // (the porcelain doll's fifth hand)
    for (int g = 0; g < 2; g++) {
        int x = 2, y = PIPS_Y + g * 11, k = g ? n : np, left = g ? discLeft : playsLeft;   // (two rows, left of the head)
        btnGlyph(x, y, g ? '^' : 'B');
        x += 10;
        gfx_fillRoundRect(x, y, k * 5 + 1, 9, 1, P_INK);
        for (int i = 0; i < k; i++) gfx_fillRoundRect(x + 1 + i * 5, y + 1, 4, 7, 1, i < left ? (g ? P_RED : P_CHIP) : P_DARK);
    }
}
static void chipMult(int x, int y, int chips, int mult, uint8_t sc) {
    int bw = sc == 2 ? 44 : 24, bh = sc == 2 ? 16 : 11;
    for (int b = 0; b < 2; b++) {                    // the chips box, X, the mult box in a gold rim
        if (b) { x += bw + (sc == 2 ? 4 : 2); textOut(x, y + (bh - 7) / 2, "X", P_TEXT); x += 8; rr3(x - 1, y - 1, bw + 2, bh + 2, P_GOLD); }
        rr2(x, y, bw, bh, b ? P_RED : P_CHIP);
        hline(x + 2, y + 1, bw - 4, P_TEXT);         // a glossy top edge
        hline(x + 2, y + bh - 2, bw - 4, P_INK);     // and a shaded foot
        const char *s = strf("%d", b ? mult : chips);
        gfx_textFx(x + (bw - gfx_textWidthScaled(s, sc)) / 2, y + (bh - 7 * sc) / 2, s, sc, P_TEXT, P_INK);
    }
}
static void labelPill(int x, int y, const char *s) {   // the hand's name: dark pill, gold rim
    int w = gfx_textWidth(s) + 7;
    if (x < 0) x = (128 - w) / 2;
    rim(x, y, w, 11, P_GOLDDK, P_BG, 2);
    gfx_text(x + 4, y + 2, s, P_GOLD);
    pix(x + 2, y + 5, P_GOLD); pix(x + w - 3, y + 5, P_GOLD);   // studs
}
static void hintBar() {                               // the buttons' legend floats along the top, under the progress line
    #define W ((const char *)(wh_tabs + T_HINTW))   // "PICK", "PLAY", "TOSS"   // (in RAM, from the card: tools/tables.py)
    static const char K[] = "AB^";
    for (int i = 0; i < 3; i++) { int x = 4 + i * 42; btnGlyph(x, LEG_Y, K[i]); textOut(x + 11, LEG_Y + 1, W + i * 5, P_CARD); }
}

// ---------------------------------------------------------------- mascot (Wild Jack)
static void drawMascot(int x, int y, int sc, uint8_t md) {
    const uint8_t *a = ART_MASCOT;
    int f70 = fc % 70;
    bool blink = f70 < 3;
    if (md == 1) a = ART_MASCOT_WOW; else if (md == 2) a = ART_MASCOT_SAD; else if (blink) a = ART_MASCOT_BLINK;
    if (md == 0 && f70 == 0) gag(Gag::Blink);
    drawArt(a, x, y + isinK(4) / 40, sc);
}

// ---------------------------------------------------------------- screens
static uint8_t stT;                                    // frames in this state
static uint8_t lastPlays = PLAYS, lastDiscs = DISCS;

__attribute__((section(".rodata.whver"))) static const char WH_VER[] = WH_VERSTR;                    // the version (tools/songs.py VERSION: bump with every build; the .CHG header's too)
static void drawTitle() {
    drawFelt();
    // a fan of a royal flush, gently bobbing; a severed hand crawls up over it now and then
    // mid: two chains swinging from the rafters, the hooks bloodied
    for (int k = 0; k < 26; k++) gfx_fillRect(12 + (k / 13) * 102 + isinF(2, k / 13 * 80) * (k % 13) / 160, (k % 13) * 3, 2, 2, k % 13 == 12 ? P_RED : (k & 1) ? P_GREY : P_SHADE);
    int peek = (fc % 240);
    int py = peek - 90 < 160 - peek ? peek - 90 : 160 - peek; py = py < 0 ? 0 : py > 10 ? 20 : py * 2;   // up 10 frames, hold, down
    if (peek == 90) gag(Gag::Peek);
    for (int i = 0; i < 5; i++) {
        Card c = { (uint8_t)(12 - i), 3 };
        if (i == 2) c.s = 0;
        int x = 22 + i * 14, y = 9 + (i == 2 ? -2 : (i == 1 || i == 3) ? 0 : 3) + isinF(3, i * 40) / 48;
        cardShadow(x, y, CW, CH);
        drawFace(x, y, c, i == 2 ? F_PICK : F_NONE);
    }
    if (py) drawArt(ART_W12, 92 + ((fc >> 3) & 1), 44 - py, 2);
    #define RAMP ((const uint8_t *)(wh_tabs + T_RAMP))   // (in RAM, from the card: tools/tables.py)
    bool gone = (fc % 173) < 4 && !fxLow;               // the lettering gutters like a bad bulb
    textFxC(46, "WILD", 3, P_RED, P_INK, gone ? nullptr : RAMP);
    for (int i = 0; i < 6; i++) {                        // blood runs from the letters, drop by drop
        int x = 32 + i * 13 + (i & 1) * 3, len = (fc / 3 + i * 23) % 40;
        int l = len < 14 ? len : 14, dyp = len < 14 ? 0 : ((len - 14) * (len - 14)) >> 2;
        gfx_vline(x, 67, l / 2 + 1, P_RED);
        if (len >= 14 && 68 + dyp < 92) gfx_fillRect(x, 68 + dyp, 1, 2, P_RED);
    }
    #define RAMP2 ((const uint8_t *)(wh_tabs + T_RAMP2))   // (in RAM, from the card: tools/tables.py)
    textFxC(69, "HAND", 3, gone ? P_GREY : P_CARD, P_WINE, gone ? nullptr : RAMP2);
    #define SHIM ((const uint8_t *)(wh_tabs + T_SHIM))   // (in RAM, from the card: tools/tables.py)
    int sx = (fc * 3) % 420 - 100;                       // a gleam slants across the lettering now and then
    for (int k = 0; k < 4; k++) remap(sx - k * 3, 46 + k * 11, 7, 11, SHIM);
    hline(6, 95, 10, P_WINE); hline(112, 95, 10, P_WINE);
    glyph(wh_tabs + T_HANDP, 12, 7, 106, 54, P_WINE);                // a bloody handprint
    gfx_vline(109, 66, 5, P_RED);
    candles(-8);
    textOut(127 - gfx_textWidth(WH_VER), 0, WH_VER, P_GREY);   // the version, top right
    if (titleN() < 4) textCT(92, 4, TX_T_TAG, P_GOLD);   // (with a save the four lines need the room)
    drawTitleMenu();
}

__attribute__((noinline)) static void drawPlay() {
    drawFelt();
    drawHud();
    handDraw();                                        // (the pause menu is drawPause: it covers the hand)
    int n = selCount();
    if (n) {
        Card c[5]; int k = 0; bool dark = false; for (int i = 0; i < nHand; i++) if (sel[i]) { c[k++] = hand[i]; dark |= hidden[i]; }
        uint8_t t; bool sc[5]; evaluate(c, k, t, sc);
        if (dark) labelPill(3, HINT_Y - 2, miscText(TX_M_Q));            // a face-down card keeps its secret
        else { labelPill(3, HINT_Y - 2, miscText(TX_M_HAND + t)); chipMult(124 - 58, HINT_Y - 2, handChips(t), handMult(t), 1); }
    } else playIdle();
    hintBar();
}

static void drawResult() {
    drawFelt();
    drawHud();
    int t = timer;
    // the played cards rise in one by one; scoring cards lift and glow
    int n = lastN, w = n * 25 - 1, left = (128 - w) / 2;
    int trail = lvl(150, 80, 3);
    for (int i = 0; i < n; i++) {
        int ti = t - i * 2;
        if (ti < 0) continue;
        int y = 78 - (lastScoring[i] && ti > 12 ? 2 : 0);   // (low: the head shows over them)
        if (ti < 8) y += (8 - ti) * (8 - ti);            // ease out from below
        int x = left + i * 25 + ox, yy = y + oy;
        if (trail && ti < 10) for (int k = 1; k <= trail; k++) remap(x, yy + k * 4, CW, CH, SHIM);   // (a glowing wake: the backdrop lit in the card's shape)
        cardShadow(x, yy, CW, CH);
        int sh = (lastScoring[i] && ti > 12 && ti < 18) ? ((t & 1) ? 1 : -1) : 0;   // a happy wiggle, card by card
        if (lastScoring[i] && ti == 13) burst(x + 12, yy + 4, 3, P_GLOW, P_TEXT, 14);
        drawFaceSheared(x, yy + (!lastScoring[i] && ti > 12 ? 3 : 0), lastCards[i], lastScoring[i] && ti > 12 ? F_SCORE : F_NONE, sh);
    }
    // the hand's name, then chips x mult counting up
    if (t >= 4) labelPill(-1, HINT_Y - 2 + (t < 8 ? 8 - t : 0), miscText(TX_M_HAND + lastType));   // (in the plate's row, as in play)
    int k = t < 6 ? 0 : t > 20 ? 14 : t - 6;
    const int re = resEnd(), per = timed ? 2 : 6;
    int s = !nEv ? 1 : t < 22 ? 0 : (t - 22) / per + 1;                // the tally: the base, then after each wild card that fired, then the total
    if (s > nEv) s = nEv + 1;
    int dc = s > nEv ? lastChips : evC[s], dm = s > nEv ? lastMult : evM[s];
    if (t >= 6) chipMult(14, 112 - (t > re && t < re + 5 ? 3 - (t - re - 1) / 2 : 0), dc * k / 14, dm * k / 14 > 0 ? dm * k / 14 : 1, 2);
    if (t > re) blinkA();
}

static void drawPause() {
    drawFelt();                                        // (the menu covers the hand: the felt and the HUD are enough)
    if (0x8E >> pauseFrom & 1) drawHud();   // (no run to show from the title and the bonus screens)
    #define DIM ((const uint8_t *)(wh_tabs + T_DIM))   // (in RAM, from the card: tools/tables.py)
    const uint8_t (*DR)[4] = (const uint8_t (*)[4])(wh_tabs + T_DR);   // only what the menu does not cover
    for (int i = 0; i < 4; i++) remap(DR[i][0], DR[i][1], DR[i][2], DR[i][3], DIM);
    drawPauseMenu();
}

// string i of text block g on the card (tools/card_text.py): use it before the next card read
static const char *cardText(uint8_t g, uint8_t i) {
    const char *p = (const char *)card::at(CARD_TEXT + 512u * g);
    if (!p) return "";
    while (i--) while (*p++) {}
    return p;
}
// text line i of block g, centred (with an outline): one call each
__attribute__((noinline)) static void textCT(int y, uint8_t g, uint8_t i, uint8_t col) { textC(y, cardText(g, i), col); }
__attribute__((noinline)) static void textOutCT(int y, uint8_t g, uint8_t i, uint8_t col, uint8_t sc = 1) { textOutC(y, cardText(g, i), col, sc); }
// text line i of block g as a format (one or two numbers), centred: one call each
__attribute__((noinline)) static void textCF(int y, uint8_t g, uint8_t i, int a, int b, uint8_t col) { textC(y, strf(cardText(g, i), a, b), col); }
// the shop's lines in text block 0, after the 24 names (tools/card_text.py SHOP)
static const char *descOf(uint8_t id) { return id < 20 ? cardText(1, id) : cardText(5, id - 20); }    // (what a wild card does: block 1, then block 5)
enum { TX_STEP = NJOK, TX_PLEASURE, TX_NOCASH, TX_FULL, TX_OFF, TX_SHUFFLE, TX_NEWOFF, TX_COSTS, TX_NEXTRND, TX_REROLL, TX_NEXT, TX_SOLD, TX_GOALF };
// a line of patter beside Wild Jack, outlined on the backdrop; broken at the first space past its middle if it is too long
static void patter(const char *s) {
    if (gfx_textWidth(s) < 90) { textOut(37, 24, s, P_CARD); return; }
    char b[24];
    int k = (int)strlen(s) / 2;
    while (s[k] && s[k] != ' ') k++;
    memcpy(b, s, k); b[k] = 0;
    textOut(37, 19, b, P_CARD);
    textOut(37, 29, s + k + (s[k] != 0), P_CARD);
}
__attribute__((noinline)) static void drawShop() {
    drawFelt();
    drawTopBar();
    // Wild Jack, big, and his patter
    uint8_t sayI = TX_STEP;
    uint8_t md = 0;
    if (note) {
        if (note == N_BOUGHT) { sayI = TX_PLEASURE; md = 1; }
        else if (note == N_NOCASH) { sayI = TX_NOCASH; md = 2; }
        else if (note == N_FULL) { sayI = TX_FULL; md = 2; }
    } else if (shopSel == shopN + 1) sayI = TX_OFF;       // (ONWARD, the button after REROLL: three offers or four)
    else if (shopSel == shopN) sayI = TX_SHUFFLE;
    drawMascot(2, 13, 2, md);
    patter(shopMode ? cardText(6, shopMode == 2 ? TX_Y_SURE : note ? TX_Y_FIRST : TX_Y_YOURS) : cardText(0, sayI));
    // the cards for sale (three, or four after a hex), or yours (up to five) to sell or throw: three big tiles, or narrow ones
    const int n = shopMode ? nJok : shopN, sel = shopMode ? ownSel : shopSel, st = tileStride(n), tw = n <= 3 ? 38 : st - 2, sc = n <= 3 ? 2 : 1, a = sc * 16, th = sc == 2 ? 50 : 34;
    for (int i = 0; i < n; i++) {
        uint8_t id = shopMode ? jokers[i] : shopOffer[i];
        bool on = sel == i;
        int x = 3 + i * st, y = (sc == 2 ? 47 : 55) - (on ? 3 + isinK(6) / 40 : 0);
        rr3(x + 1, y + 2, tw, th, P_INK);
        if (id == 255) {
            gfx_roundRect(x, y, tw, th, 3, on ? P_GLOW : P_GREY);
            textOut(x + (tw >> 1) - 14, y + (th >> 1) - 4, cardText(0, TX_SOLD), P_SHADE);
            continue;
        }
        rr3(x, y, tw, th, on ? P_GOLD : P_GOLDDK);
        rr2(x + (on ? 2 : 1), y + (on ? 2 : 1), tw - (on ? 4 : 2), th - (on ? 4 : 2), P_BG);
        int ax = x + (tw - a) / 2, ay = y + (sc == 2 ? 3 : 4);
        wildPic(wildRec(id), ax, ay, sc * 8);
        int gl = (fc * 2) % 180 - 20;                       // a glint sweeps the card under the cursor
        if (on && gl < 70) { gfx_setClip(ax, ay, a, a); gfx_line(ax + gl, ay, ax + gl - a, ay + a, P_TEXT); gfx_resetClip(); }
        int pr = shopMode ? jprice(id) / 2 : jprice(id);
        const char *s = strf("$%d", pr);
        rr2(x + (tw - 20) / 2, ay + a + 2, 20, 10, P_INK);
        gfx_text(x + (tw >> 1) - (gfx_textWidth(s) >> 1), ay + a + 4, s, shopMode ? P_GLOW : money >= pr ? P_GOLD : P_RED);
    }
    // what the highlighted card does: two lines floating on the backdrop
    const uint8_t sid = shopMode ? jokers[ownSel] : shopSel < shopN ? shopOffer[shopSel] : 255;
    if (shopMode == 2) {                                    // SELL (half back), THROW (nothing back), CANCEL
        textOutCT(100, 6, TX_Y_HALF + confSel, P_GOLD);
        int x = 6;
        for (int k = 0; k < 3; k++) {
            const char *l = cardText(6, TX_Y_SELL + k);
            if (!k) l = strf(l, jprice(sid) / 2);
            int w = gfx_textWidth(l);
            if (k == confSel) { rr2(x - 2, 109, w + 4, 9, P_GOLD); gfx_text(x, 110, l, P_INK); } else textOut(x, 110, l, P_TEXT);
            x += w + 5;
        }
    } else if (sid != 255) {
        const char *cb = shopMode ? nullptr : comboHint(sid); textOutC(100, cb ? cb : cardText(0, sid), cb ? P_RED : P_GOLD);
        textOutC(109, descOf(sid), P_TEXT);
    } else if (shopSel == shopN) { textOutCT(100, 0, TX_NEWOFF, P_GOLD); textOutCT(109, 0, TX_COSTS, P_TEXT); }
    else { textOutCT(100, 0, TX_NEXTRND, P_GOLD); textOutC(109, strf(cardText(0, TX_GOALF), goal()), P_TEXT); }
    // buttons: dark pills, the chosen one gold
    for (int i = 0; i < 2; i++) {
        bool on = !shopMode && shopSel == shopN + i;
        int x = 3 + i * 62;
        if (on) gfx_roundRect(x - 1, 117, 62, 12, 3, (fc & 8) ? P_GLOW : P_WINE);   // a rim breathes round the chosen button
        rr2(x, 118, 60, 10, on ? P_GOLD : P_INK);
        const char *b = cardText(0, TX_REROLL + i);
        gfx_text(x + 30 - (gfx_textWidth(b) >> 1), 120, b, on ? P_INK : P_TEXT);
    }
}

static void drawEnd() {
    bool won = state == WON;
    drawFelt();
    rim(6, 63, 116, 24, P_GOLDDK, P_BG, 3);
    if (won) {
        if ((fc & 3) == 0) confetti();
        int jump = isinK(10); if (jump > 0) jump = -jump;
        drawMascot(48, 8 + jump / 8, 2, 1);
        int8_t dy[8]; for (int i = 0; i < 8; i++) dy[i] = (int8_t)(isinF(6, i * 32) / 24);
        const char *t = cardText(4, TX_U_SURV);
        textFxC(46, t, 2, P_GOLD, P_WINE, nullptr, dy);
        textCT(66, 4, TX_E_DAWN, P_TEXT);
        for (int i = 0; i < 5; i++) {                    // a royal flush takes a bow
            Card c = { (uint8_t)(8 + i), 0 };
            int x = 6 + i * 24, y = 98 + (isinF(8, i * 40) >> 4);
            cardShadow(x, y, CW, CH); drawFace(x, y, c, F_SCORE);
        }
    } else {
        // the house of cards collapses
        if (stT < 40 && (stT & 3) == 0) drift(20 + fr(88), 40, -35, P_CARD, P_CARD, 50);
        drawMascot(48, 8, 2, 2);
        rainCloud();
        int dl = stT > 90 ? 90 : stT; if (fxLow) dl >>= 2;
        for (int i = 0; i < 8; i++) gfx_fillRect(5 + i * 16 + (i & 1) * 5, 0, 2, dl * (2 + (i * 7) % 5) / 8, P_RED);   // blood runs down the screen
        int wob = (isinK(5) >> 5);
        textOutCT(46 + wob, 4, TX_E_DIED, P_RED, 2);
        textCF(66, 4, TX_E_LIVED, round_, 0, P_TEXT);
        const int8_t *PX = (const int8_t *)(wh_tabs + T_PXYS), *PY = PX + 5, *PS = PX + 10;
        for (int i = 0; i < 5; i++) {                    // the house of cards, fallen
            int y = PY[i] + (stT < 20 ? ((20 - stT) * (20 - stT)) >> 2 : 0);
            cardShadow(PX[i], y, CW, CH);
            if (i & 1) drawBack(PX[i], y, CW); else { Card c = { (uint8_t)(i * 2), (uint8_t)(i & 3) }; drawFaceSheared(PX[i], y, c, F_NONE, PS[i]); }
        }
        gfx_fillRect(0, 127 - dl / 9, 128, 4, P_WINE);   // the cards lie in a spreading pool
    }
    textCF(77, 4, TX_E_BEST, (int)hiRound, 0, P_TEXT);
    endPrompt(89);
}

// ---------------------------------------------------------------- frame
__attribute__((noinline)) static void stateEvents() {
    static bool big;                                    // the hand just played was a big one (set as the result opens)
    if (state != lastSt) {
        if (state == RESULT) {
            gag(Gag::Play);
            big = lastGain * 3 >= (int)goal() || lastType >= 4;
            if (big) { streak++; heatKick(30 + lastType * 4); } else streak = 0;
        }
        if (state == SHOP && lastSt == RESULT) { gag(Gag::Clear); heatKick(20); }
        if (state == OVER) { gag(Gag::Bust); heatFloor = 0; streak = 0; memset(parts, 0, sizeof parts); }
        if (state == WON) { gag(Gag::Jackpot); heatFloor = 0; }
        if (state == TITLE) { heat = 0; streak = 0; }
        stT = 0;
        lastSt = state;
    } else if (stT < 255) stT++;
    // result beats: tally pop, big hand
    if (state == RESULT) {
        if (timer == resEnd() + 1) {
            gag(Gag::Tally);
            int amt = 10 + lvl(0, 255, 30);
            burst(64, 110, big ? amt : 6, big && !fxLow ? P_RED : P_GOLD, big ? P_WINE : P_GLOW, big ? 40 : 20);   // a big hand spills blood
            if (big) { gag(Gag::BigHand); shakeT = 10; shakeAmp = 2 + lvl(120, 100, 2); flashT = 4; 
                #define BL ((const uint8_t (*)[4])(wh_tabs + T_BL))   // three splats   // (in RAM, from the card: tools/tables.py)
                for (int k = 0; k < 3; k++) { const uint8_t *b = BL[k]; int xx = b[0] + fr(b[1]); bleed(xx, b[2] + fr(b[3])); }
            }
        }
        if (timer >= 6 && timer <= 20 && (timer & 1)) spark(16, 108, 96);   // the tally throws sparks
        if (timer == 13) { shakeT = 4; shakeAmp = 1;                    // each scoring card thumps the table
            for (int i = 0; i < lastN; i++) if (lastScoring[i]) burst((128 - lastN * 25) / 2 + i * 25 + 12, 82, 4, P_GLOW, P_TEXT, 26); }   // the scoring cards sparkle
        if (timer == resEnd() + 8) for (int i = 0; i < 10; i++) spawn(30 + i * 7, 108, (SCORE_R - 24 - (30 + i * 7)) * 16 / 14, -(108 - SCORE_Y - 6) * 16 / 14, i & 1 ? P_CHIP : P_RED, 14);   // the chips fly to the score
    }
    if (state == SHOP && note && !moodT) {             // once per note
        moodT = 1;
        if (note == N_BOUGHT) { gag(Gag::Buy); burst(18, 28, 10, P_GOLD, P_GLOW, 24); }
        else if (note == N_NOCASH) gag(Gag::Broke); else if (note == N_FULL) gag(Gag::Full);
    }
    // a riffle shuffle of the hand between plays once it is hot
    bool riffle = false;
    if (state == PLAY && (playsLeft != lastPlays || discLeft != lastDiscs)) {
        if (heat >= 120 && playsLeft != PLAYS) { riffle = true; gag(Gag::Riffle); }
        if (discLeft < lastDiscs) bleed(118, 92);       // the tossed cards leave a smear
        lastPlays = playsLeft; lastDiscs = discLeft;
    }
    if (state == PLAY) handSync(riffle);
    if (state == TITLE || state == SHOP) { shownN = 0; lastPlays = PLAYS; lastDiscs = DISCS; }
    if (state == BONUS) shownN = 0;                    // (the timed bonus deals a fresh hand: no card slides over from the night before)
}

// the screens arrive by a wipe: sideways shutters
static void wipe(int t) {
    int cw = 128 - 14 * t;
    for (int i = 0; i < 16; i++) {
        int a = i & 1 ? 128 - cw : 0, b = i & 1 ? 127 - cw : cw;
        gfx_fillRect(a, i * 8, cw, 8, P_BG); gfx_vline(b, i * 8, 8, P_RED);
    }
}
static void draw() {
    fc++;
    stateEvents();
    heatTick();
    palTick();
    // shake: from big hands, and a constant rumble near the top of the meter
    int amp = shakeT ? shakeAmp : lvl(190, 60, 2);
    if (shakeT) shakeT--;
    if (fxLow) amp = 0;
    if (amp && (state == PLAY || state == RESULT)) { ox = fr(2 * amp + 1) - amp; oy = fr(2 * amp + 1) - amp; } else ox = oy = 0;
    // ambient sparks once it is hot
    int sp = lvl(150, 100, 6);
    if (sp && (state == PLAY || state == RESULT) && (frand() & 15) < sp) drift((frand() & 1) ? fr(12) : 116 + fr(12), 127, -29, P_GOLD, P_GLOW, 24);
    switch (state) {
    case TITLE: drawTitle(); break;
    case SHOP: drawShop(); break;
    case OVER: case WON: drawEnd(); break;
    case RESULT: drawResult(); break;
    case PAUSED: drawPause(); break;
    case DEAL: case BONUS: case TIMEUP: case MINI: case BSEL: drawExtra(); break;
    default: if (showLv) drawOverlay(); else drawPlay(); break;
    }
    partsDraw(state == WON ? 0 : 2);
    if (shakeT && !fxLow && (state == RESULT || state == PLAY)) { uint8_t c = (shakeT & 2) ? P_RED : P_GOLD; gfx_rect(0, 0, 128, 128, c); }   // a big hand flashes the frame
    if (stT < 10 && (state == TITLE || state == SHOP || state == OVER || state == WON)) wipe(stT);
}

#if CHGAME_DEBUG
// debug commands (simulator scripts: `say H 220`): H heat floor, W win, O over, R round, M money, J three wild cards
static bool gfxHook(char cmd, const char *a) {
    switch (cmd) {
    case 'H': heatForce = (uint8_t)dbg::parseNum(a, 10); heat = heatForce; return true;
    case 'W': state = WON; return true;
    case 'O': state = OVER; return true;
    case 'X': openShop(); return true;
    case 'R': round_ = (uint8_t)dbg::parseNum(a, 10); return true;
#ifndef PERF_BUILD
    case 'M': money = (int32_t)dbg::parseNum(a, 10); return true;
    case 'C': { int n = (int)dbg::parseNum(a, 10); cardSz = (uint8_t)(n % 5); idxSz = (uint8_t)(n / 10 % 5); return true; }   // the CARD size, tens: the INDEX size (C 21: INDEX LARGE)
#endif
    case 'J': { const char *q = a; clearJok(); while (nJok < JMAX && *q) { while (*q == ' ' || *q == ',') q++; if (!*q) break; addJok((uint8_t)(dbg::parseNum(q, 10) % NJOK)); } return true; }   // J 0 1 20: those wild cards
    }
    return false;
}
#endif
static void gfxInit() {
    uint16_t pal[16];
    for (int i = 0; i < 16; i++) pal[i] = gfx_rgb(BASEPAL[i][0], BASEPAL[i][1], BASEPAL[i][2]);
    gfx_setPalette(pal, 16);
#if CHGAME_DEBUG
    dbg::hook = gfxHook;
#endif
}
